## Kconfig
```kconfig
# Copyright (c) 2024 The ZMK Contributors
# SPDX-License-Identifier: MIT

config ZMK_USB_HID_BATTERY_REPORTING
    bool "USB HID Battery Level Reporting"
    default y
    depends on ZMK_USB
    help
      Report battery level over USB HID as a Feature Report.
      This allows the host OS to read battery status from the keyboard.
      For dongles without a local battery, enable ZMK_USB_HID_BATTERY_REPORTING_SPLIT
      to report peripheral battery levels.

config ZMK_USB_HID_BATTERY_REPORTING_SPLIT
    bool "Report split keyboard peripheral batteries"
    default y
    depends on ZMK_USB_HID_BATTERY_REPORTING && ZMK_SPLIT_BLE_CENTRAL_BATTERY_LEVEL_FETCHING
    help
      Include peripheral battery levels in the USB HID battery report.
      Each half of a split keyboard will have its battery reported separately.
      This is required for dongles that have no local battery.
```
